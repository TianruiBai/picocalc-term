## boards/arm/rp23xx/picocalc-rp2350b/Kconfig
```kconfig
#
# boards/arm/rp23xx/picocalc-rp2350b/Kconfig
#
# Board-specific Kconfig options for PicoCalc RP2350B-Plus-W
#

if ARCH_BOARD_CUSTOM

config PICOCALC_LCD_ST7365P
	bool "ST7365P LCD display driver"
	default y
	depends on VIDEO_FB && RP23XX_SPI1
	select FB_UPDATE
	---help---
		Enable the ST7365P (ILI9488-compatible) 320x320 LCD driver
		on SPI1. Registers as /dev/fb0.

config PICOCALC_LCD_SPI_FREQ
	int "LCD SPI frequency (Hz)"
	default 25000000
	depends on PICOCALC_LCD_ST7365P
	---help---
		SPI clock frequency for the ST7365P display.
		Maximum supported: 25 MHz.

config PICOCALC_KEYBOARD
	bool "PicoCalc I2C keyboard driver"
	default y
	depends on RP23XX_I2C1
	select INPUT_KEYBOARD
	---help---
		Enable the PicoCalc 67-key QWERTY keyboard driver.
		Communicates with STM32 south-bridge via I2C1 at 0x1F.

config PICOCALC_PSRAM
	bool "PSRAM support (8 MB)"
	default y
	---help---
		Enable 8 MB PSRAM on the PicoCalc mainboard.
		Creates a separate heap for large allocations
		(framebuffer, editor buffers, audio buffers).

config PICOCALC_AUDIO_PWM
	bool "PWM audio output"
	default y
	---help---
		Enable dual PWM audio output on GP26 (left) / GP27 (right).
		Uses PWM slice 5 at ~44.1 kHz with 10-bit resolution.

config PICOCALC_PIO_SDIO
	bool "PIO-based 1-bit SDIO for SD card"
	default n
	---help---
		Use PIO1-simulated 1-bit SDIO instead of SPI0 for SD card
		access. Provides faster transfers (~3 MB/s vs ~2 MB/s).
		Uses CLK=GP18, CMD=GP19, DAT0=GP16 on PIO1.

config PICOCALC_WIFI
	bool "Wi-Fi support (CYW43439)"
	default n
	depends on NET
	select DRIVERS_IEEE80211
	select DRIVERS_WIRELESS
	select IEEE80211_BROADCOM_FULLMAC_GSPI
	select IEEE80211_INFINEON_CYW43439
	select NETDEV_WIRELESS_IOCTL
	---help---
		Enable CYW43439 Wi-Fi driver. Requires network stack.

if PICOCALC_WIFI

config CYW43439_FIRMWARE_BIN_PATH
	string "Path to Infineon 43439 firmware file"
	default "${PICO_SDK_PATH}/lib/cyw43-driver/firmware/43439A0-7.95.49.00.combined"
	---help---
		Path to the combined CYW43439 firmware+CLM blob image.

config CYW43439_FIRMWARE_LEN
	int "Infineon 43439 firmware length (bytes)"
	default 224190
	---help---
		Length of the base firmware region before the appended CLM blob.

endif

config PICOCALC_HOSTNAME
	string "Default hostname"
	default "picocalc"
	---help---
		Default hostname for the device, used in terminal prompt
		and network identity. Can be changed at runtime via
		/flash/etc/hostname.

endif # ARCH_BOARD_CUSTOM
```

## boards/arm/rp23xx/picocalc-rp2350b/configs/full/defconfig
```kconfig
#
# boards/arm/rp23xx/picocalc-rp2350b/configs/full/defconfig
#
# eUX OS full configuration
# Includes: ROMFS root filesystem, display, keyboard, LVGL,
# audio, Wi-Fi, runit services, all built-in apps
#

# --- Host ---
CONFIG_HOST_LINUX=y

# --- Architecture ---
CONFIG_ARCH="arm"
CONFIG_ARCH_ARM=y
CONFIG_ARCH_CHIP="rp23xx"
CONFIG_ARCH_CHIP_RP23XX=y
CONFIG_RP23XX_RP2350B=y
CONFIG_ARCH_BOARD_CUSTOM=y
CONFIG_ARCH_BOARD_CUSTOM_NAME="picocalc-rp2350b"
CONFIG_ARCH_BOARD_CUSTOM_DIR="boards/arm/rp23xx/picocalc-rp2350b"
CONFIG_ARCH_BOARD_CUSTOM_DIR_RELPATH=y
CONFIG_ARCH_RAMVECTORS=y
CONFIG_ARCH_STACKDUMP=y
CONFIG_BOOT_RUNFROMFLASH=y
CONFIG_BOARD_LOOPSPERMSEC=15000
CONFIG_START_YEAR=2025
CONFIG_START_MONTH=1
CONFIG_START_DAY=1
CONFIG_RAM_START=0x20000000
CONFIG_RAM_SIZE=532480
CONFIG_BOARD_LATE_INITIALIZE=y

# --- Build ---
CONFIG_APPS_DIR="../nuttx-apps"
CONFIG_BUILTIN=y
CONFIG_DEBUG_FULLOPT=y
CONFIG_DEBUG_SYMBOLS=y

# --- Peripherals ---
CONFIG_RP23XX_UART0=y
CONFIG_UART0_SERIAL_CONSOLE=y
CONFIG_UART0_BAUD=115200
CONFIG_RP23XX_SPI=y
CONFIG_RP23XX_SPI0=y
CONFIG_RP23XX_SPI1=y
CONFIG_RP23XX_SPI1_SCK_GPIO=10
CONFIG_RP23XX_SPI1_TX_GPIO=11
CONFIG_RP23XX_SPI1_RX_GPIO=12
CONFIG_RP23XX_SPI1_CS_GPIO=13
CONFIG_ARCH_BOARD_COMMON=y
CONFIG_RP23XX_I2C=y
CONFIG_RP23XX_I2C1=y
CONFIG_RP23XX_I2C1_SDA_GPIO=6
CONFIG_RP23XX_I2C1_SCL_GPIO=7
CONFIG_I2C=y
CONFIG_I2C_DRIVER=y

# --- Display ---
CONFIG_DRIVERS_VIDEO=y
CONFIG_VIDEO_FB=y
CONFIG_FB_UPDATE=y
CONFIG_PICOCALC_LCD_ST7365P=y

# --- Keyboard ---
CONFIG_INPUT=y
CONFIG_INPUT_KEYBOARD=y
CONFIG_PICOCALC_KEYBOARD=y

# --- PSRAM ---
CONFIG_PICOCALC_PSRAM=y

# --- Audio ---
CONFIG_PICOCALC_AUDIO_PWM=y

# --- SD Card + Filesystems ---
CONFIG_MMCSD=y
CONFIG_MMCSD_SPI=y
CONFIG_FS_FAT=y
CONFIG_FAT_LCNAMES=y
CONFIG_FS_PROCFS=y
CONFIG_FS_TMPFS=y
CONFIG_FS_ROMFS=y

# --- ROMFS root filesystem (/etc) ---
CONFIG_NSH_ROMFSETC=y
CONFIG_NSH_ROMFSRC=y
CONFIG_NSH_INITSCRIPT="init.d/rcS"
CONFIG_NSH_ROMFSMOUNTPT="/etc"
CONFIG_NSH_ROMFSDEVNO=0
CONFIG_NSH_ROMFSSECTSIZE=64

# --- LVGL v9 ---
CONFIG_GRAPHICS_LVGL=y
CONFIG_LV_USE_NUTTX=y
CONFIG_LV_USE_NUTTX_FBDEV=y
CONFIG_LV_MEM_SIZE_KILOBYTES=48
CONFIG_LV_COLOR_DEPTH_16=y
CONFIG_LV_DPI_DEF=160
CONFIG_LV_FONT_MONTSERRAT_12=y
CONFIG_LV_FONT_MONTSERRAT_14=y
CONFIG_LV_FONT_MONTSERRAT_16=y
CONFIG_LV_FONT_UNSCII_8=y
CONFIG_LV_FONT_DEFAULT_MONTSERRAT_14=y
CONFIG_LV_USE_LABEL=y
CONFIG_LV_USE_BUTTON=y
CONFIG_LV_USE_BUTTONMATRIX=y
CONFIG_LV_USE_TABLE=y
CONFIG_LV_USE_TEXTAREA=y
CONFIG_LV_USE_KEYBOARD=y
CONFIG_LV_USE_ROLLER=y
CONFIG_LV_USE_DROPDOWN=y
CONFIG_LV_USE_CHECKBOX=y
CONFIG_LV_USE_SWITCH=y
CONFIG_LV_USE_SLIDER=y
CONFIG_LV_USE_BAR=y
CONFIG_LV_USE_LIST=y
CONFIG_LV_USE_TABVIEW=y
CONFIG_LV_USE_MSGBOX=y
CONFIG_LV_USE_WIN=y

# --- Network ---
CONFIG_ALLOW_BSD_COMPONENTS=y
CONFIG_DRIVERS_IEEE80211=y
CONFIG_DRIVERS_WIRELESS=y
CONFIG_IEEE80211_BROADCOM_FULLMAC_GSPI=y
CONFIG_IEEE80211_INFINEON_CYW43439=y
CONFIG_NET=y
CONFIG_NET_TCP=y
CONFIG_NET_UDP=y
CONFIG_NET_ICMP=y
CONFIG_NET_SOCKOPTS=y
CONFIG_NET_TCP_WRITE_BUFFERS=y
CONFIG_NET_IPv4=y
CONFIG_NETDEV_WIRELESS_IOCTL=y
CONFIG_NETDB_DNSCLIENT=y
CONFIG_NETUTILS_NETLIB=y
CONFIG_NETUTILS_DHCPC=y
CONFIG_NETDEV_LATEINIT=y
CONFIG_NETUTILS_CJSON=y
CONFIG_WIRELESS_WAPI=y
CONFIG_PICOCALC_WIFI=y

# --- Crypto (for SSH/TLS) ---
CONFIG_CRYPTO=y
CONFIG_ALLOW_GPL_COMPONENTS=y
CONFIG_CRYPTO_WOLFSSL=y
CONFIG_CRYPTO_WOLFSSH=y
CONFIG_CRYPTO_WOLFSSH_SCP=y

# --- Internal Flash Filesystem ---
CONFIG_MTD=y
CONFIG_RP23XX_FLASH_FILE_SYSTEM=y
CONFIG_FS_LITTLEFS=y

# --- Pseudo-terminals (for local terminal) ---
CONFIG_PSEUDOTERM=y

# --- NSH (as embedded shell for pcterm app) ---
CONFIG_NSH_LIBRARY=y
CONFIG_NSH_BUILTIN_APPS=y
CONFIG_NSH_ARCHINIT=y
CONFIG_NSH_READLINE=y
CONFIG_READLINE_CMD_HISTORY=y
CONFIG_SYSTEM_NSH=y
CONFIG_SYSTEM_VI=y
CONFIG_SYSTEM_VI_COLS=40
CONFIG_SYSTEM_VI_ROWS=20
CONFIG_SYSLOG_CONSOLE=y

# --- ELF loader (for third-party apps) ---
CONFIG_ELF=y
CONFIG_LIBC_EXECFUNCS=y

# --- Hostname ---
CONFIG_PICOCALC_HOSTNAME="eux"
CONFIG_NET_HOSTNAME=y
CONFIG_LIBC_HOSTNAME_MAX=32

# --- Entry point ---
CONFIG_EXAMPLES_PCTERM=y
CONFIG_INIT_ENTRYPOINT="eux_init"
CONFIG_INIT_STACKSIZE=8192

# --- Debug (minimal for production) ---
CONFIG_DEBUG_FEATURES=y
CONFIG_DEBUG_ERROR=y
CONFIG_SYSLOG=y
CONFIG_RAMLOG=y
CONFIG_RAMLOG_SYSLOG=y
CONFIG_RAMLOG_BUFSIZE=8192
CONFIG_SYSLOG_DEVPATH="/dev/kmsg"

# --- Scheduling & Multi-threading ---
CONFIG_IRQCHAIN=y
CONFIG_RR_INTERVAL=200
CONFIG_SCHED_WAITPID=y
CONFIG_SCHED_WORKQUEUE=y
CONFIG_SCHED_HPWORK=y
CONFIG_SCHED_HPWORKSTACKSIZE=2048
CONFIG_SCHED_LPWORK=y
CONFIG_SCHED_LPWORKSTACKSIZE=2048
CONFIG_NFILE_DESCRIPTORS_PER_BLOCK=8
CONFIG_ARCH_INTERRUPTSTACK=2048
CONFIG_SCHED_CPULOAD=y
CONFIG_SCHED_CPULOAD_SYSCLK=y

# --- POSIX Threads (full support) ---
CONFIG_PTHREAD_MUTEX_TYPES=y
CONFIG_PTHREAD_MUTEX_BOTH=y
CONFIG_PTHREAD_STACK_DEFAULT=4096
CONFIG_CANCELLATION_POINTS=y
CONFIG_SCHED_HAVE_PARENT=y
CONFIG_SIG_DEFAULT=y
CONFIG_PTHREAD_MUTEX_DEFAULT_PRIO_INHERIT=y
CONFIG_PRIORITY_INHERITANCE=y
CONFIG_SEM_PREALLOCHOLDERS=8

# --- Filesystem ---
CONFIG_FS_PROCFS_REGISTER=y
CONFIG_PSEUDOFS_SOFTLINKS=y

# --- System Information Commands ---
CONFIG_SYSTEM_LSCPU=y
CONFIG_SYSTEM_LSI2C=y
CONFIG_SYSTEM_LSSPI=y
CONFIG_SYSTEM_SCREENFETCH=y
CONFIG_SYSTEM_CLOCKSET=y
CONFIG_SYSTEM_HOSTNAME=y
CONFIG_SYSTEM_PCMINIPKG=y
CONFIG_SYSTEM_PCWIFI=y
CONFIG_SYSTEM_DMESG=y

# --- Interpreters (lightweight scripting) ---
CONFIG_INTERPRETERS_LUA=y
CONFIG_INTERPRETERS_LUA_CORELIBS=y
CONFIG_INTERPRETERS_QUICKJS=y
CONFIG_INTERPRETERS_QUICKJS_MINI=y
CONFIG_INTERPRETERS_QUICKJS_STACKSIZE=16384
CONFIG_LIBC_LOCALE=y
CONFIG_SYSTEM_SYSTEM=y

# --- I2C/SPI diagnostics tools ---
CONFIG_SYSTEM_I2CTOOL=y
CONFIG_SYSTEM_SPITOOL=y

# --- CLI SSH/SCP/keygen commands for NSH ---
CONFIG_SYSTEM_PCSSH=y
CONFIG_SYSTEM_PCSCP=y
CONFIG_SYSTEM_PCSSH_KEYGEN=y
CONFIG_SYSTEM_PCTIME=y
CONFIG_SYSTEM_PCNTP=y
CONFIG_SYSTEM_PCBT=y

# --- Games ---
CONFIG_GAMES_BRICKMATCH=y
CONFIG_GAMES_BRICKMATCH_USE_LCD_SCREEN=y
CONFIG_GAMES_BRICKMATCH_USE_CONSOLEKEY=y
CONFIG_GAMES_SNAKE=y
CONFIG_GAMES_SNAKE_USE_CONSOLEKEY=y

# --- Message Queues (IPC for threading) ---
CONFIG_MQ_MAXMSGSIZE=64

# --- Named Semaphores ---
CONFIG_FS_NAMED_SEMAPHORES=y
```

## boards/arm/rp23xx/picocalc-rp2350b/configs/lvgl/defconfig
```kconfig
#
# boards/arm/rp23xx/picocalc-rp2350b/configs/lvgl/defconfig
#
# LVGL + Display + Keyboard configuration for PicoCalc RP2350B-Plus-W
# Purpose: GUI framework validation with launcher and status bar
#
# Extends nsh config with: display driver, LVGL, keyboard input
#

# --- (include nsh base options) ---
# Architecture, SPI, I2C, SD, PSRAM, NSH — same as nsh/defconfig

# --- Host ---
CONFIG_HOST_LINUX=y

CONFIG_ARCH="arm"
CONFIG_ARCH_ARM=y
CONFIG_ARCH_CHIP="rp23xx"
CONFIG_ARCH_CHIP_RP2350B=y
CONFIG_ARCH_BOARD="picocalc-rp2350b"
CONFIG_ARCH_BOARD_PICOCALC_RP2350B=y
CONFIG_BOARD_LOOPSPERMSEC=15000
CONFIG_START_YEAR=2025
CONFIG_START_MONTH=1
CONFIG_START_DAY=1
CONFIG_RAM_START=0x20000000
CONFIG_RAM_SIZE=524288
CONFIG_BOARD_LATE_INITIALIZE=y

CONFIG_RP23XX_UART0=y
CONFIG_UART0_SERIAL_CONSOLE=y
CONFIG_UART0_BAUD=115200

CONFIG_RP23XX_SPI0=y
CONFIG_RP23XX_SPI1=y
CONFIG_RP23XX_I2C1=y
CONFIG_RP23XX_I2C1_SDA_GPIO=6
CONFIG_RP23XX_I2C1_SCL_GPIO=7
CONFIG_I2C=y
CONFIG_I2C_DRIVER=y

CONFIG_MMCSD=y
CONFIG_MMCSD_SPI=y
CONFIG_FS_FAT=y
CONFIG_PICOCALC_PSRAM=y

# --- Display ---
CONFIG_VIDEO_FB=y
CONFIG_PICOCALC_LCD_ST7365P=y
CONFIG_PICOCALC_LCD_SPI_FREQ=25000000

# --- Keyboard ---
CONFIG_INPUT=y
CONFIG_INPUT_KEYBOARD=y
CONFIG_PICOCALC_KEYBOARD=y

# --- LVGL ---
CONFIG_GRAPHICS_LVGL=y
CONFIG_LV_MEM_CUSTOM=y
CONFIG_LV_MEM_SIZE_KILOBYTES=48
CONFIG_LV_COLOR_DEPTH_16=y
CONFIG_LV_COLOR_16_SWAP=y
CONFIG_LV_DPI_DEF=160
CONFIG_LV_HOR_RES_MAX=320
CONFIG_LV_VER_RES_MAX=320
CONFIG_LV_USE_LOG=y
CONFIG_LV_LOG_LEVEL_WARN=y

# LVGL display driver: framebuffer
CONFIG_LV_PORT_USE_FBDEV=y
CONFIG_LV_TICK_CUSTOM=y

# LVGL built-in fonts
CONFIG_LV_FONT_MONTSERRAT_12=y
CONFIG_LV_FONT_MONTSERRAT_14=y
CONFIG_LV_FONT_MONTSERRAT_16=y
CONFIG_LV_FONT_UNSCII_8=y
CONFIG_LV_FONT_DEFAULT_MONTSERRAT_14=y

# LVGL widgets
CONFIG_LV_USE_LABEL=y
CONFIG_LV_USE_BTN=y
CONFIG_LV_USE_BTNMATRIX=y
CONFIG_LV_USE_TABLE=y
CONFIG_LV_USE_TEXTAREA=y
CONFIG_LV_USE_KEYBOARD=y
CONFIG_LV_USE_ROLLER=y
CONFIG_LV_USE_DROPDOWN=y
CONFIG_LV_USE_CHECKBOX=y
CONFIG_LV_USE_SWITCH=y
CONFIG_LV_USE_SLIDER=y
CONFIG_LV_USE_BAR=y
CONFIG_LV_USE_LIST=y
CONFIG_LV_USE_TABVIEW=y
CONFIG_LV_USE_MSGBOX=y
CONFIG_LV_USE_WIN=y

# --- NSH (reduced, GUI is primary) ---
CONFIG_NSH_LIBRARY=y
CONFIG_NSH_BUILTIN_APPS=y
CONFIG_SYSTEM_NSH=y
CONFIG_INIT_ENTRYPOINT="nsh_main"
CONFIG_INIT_STACKSIZE=4096

# --- Filesystem ---
CONFIG_FS_PROCFS=y
CONFIG_FS_FAT=y

# --- Debug (reduced for GUI config) ---
CONFIG_DEBUG_FEATURES=y
CONFIG_DEBUG_ERROR=y
CONFIG_SYSLOG=y
```

## boards/arm/rp23xx/picocalc-rp2350b/configs/nsh/defconfig
```kconfig
#
# boards/arm/rp23xx/picocalc-rp2350b/configs/nsh/defconfig
#
# Minimal NuttShell configuration for PicoCalc RP2350B-Plus-W
# Purpose: Board bring-up and peripheral validation
#
# Usage:
#   cd nuttx
#   ./tools/configure.sh picocalc-rp2350b:nsh
#   make
#

# --- Host ---
CONFIG_HOST_LINUX=y
CONFIG_APPS_DIR="../nuttx-apps"

# --- Architecture ---
CONFIG_ARCH="arm"
CONFIG_ARCH_ARM=y
CONFIG_ARCH_CHIP="rp23xx"
CONFIG_ARCH_CHIP_RP23XX=y
CONFIG_ARCH_BOARD_CUSTOM=y
CONFIG_ARCH_BOARD_CUSTOM_NAME="picocalc-rp2350b"
CONFIG_ARCH_BOARD_CUSTOM_DIR="boards/arm/rp23xx/picocalc-rp2350b"
CONFIG_ARCH_BOARD_CUSTOM_DIR_RELPATH=y
CONFIG_BOARD_LOOPSPERMSEC=15000

# --- System ---
CONFIG_START_YEAR=2025
CONFIG_START_MONTH=1
CONFIG_START_DAY=1
CONFIG_INIT_ENTRYPOINT="nsh_main"
CONFIG_INIT_STACKSIZE=4096
CONFIG_RAM_START=0x20000000
CONFIG_RAM_SIZE=524288
CONFIG_BOARD_LATE_INITIALIZE=y

# --- UART (debug console) ---
CONFIG_RP23XX_UART0=y
CONFIG_UART0_SERIAL_CONSOLE=y
CONFIG_UART0_BAUD=115200
CONFIG_UART0_BITS=8
CONFIG_UART0_PARITY=0
CONFIG_UART0_2STOP=0

# --- SPI ---
CONFIG_RP23XX_SPI0=y
CONFIG_RP23XX_SPI1=y

# --- I2C ---
CONFIG_RP23XX_I2C1=y
CONFIG_RP23XX_I2C1_SDA_GPIO=6
CONFIG_RP23XX_I2C1_SCL_GPIO=7
CONFIG_I2C=y
CONFIG_I2C_DRIVER=y

# --- SD Card ---
CONFIG_MMCSD=y
CONFIG_MMCSD_SPI=y
CONFIG_FS_FAT=y
CONFIG_FAT_LCNAMES=y

# --- PSRAM ---
CONFIG_PICOCALC_PSRAM=y

# --- NuttShell ---
CONFIG_NSH_LIBRARY=y
CONFIG_NSH_READLINE=y
CONFIG_NSH_BUILTIN_APPS=y
CONFIG_NSH_FILEIOSIZE=512
CONFIG_NSH_STRERROR=y
CONFIG_NSH_LINELEN=128
CONFIG_NSH_CMDPARMS=y
CONFIG_NSH_MAXARGUMENTS=12
CONFIG_NSH_NESTDEPTH=3

# --- Filesystem ---
CONFIG_FS_PROCFS=y
CONFIG_FS_TMPFS=y
CONFIG_LIBC_HOMEDIR="/mnt/sd"

# --- System utilities ---
CONFIG_SYSTEM_NSH=y
CONFIG_INIT_ENTRYPOINT="nsh_main"

# --- System information commands ---
CONFIG_SYSTEM_LSCPU=y
CONFIG_SYSTEM_LSI2C=y
CONFIG_SYSTEM_LSSPI=y
CONFIG_SYSTEM_SCREENFETCH=y
CONFIG_SYSTEM_CLOCKSET=y
CONFIG_SYSTEM_HOSTNAME=y
CONFIG_SYSTEM_PCMINIPKG=y
CONFIG_SYSTEM_PCWIFI=y
CONFIG_SYSTEM_DMESG=y

# --- I2C/SPI diagnostics ---
CONFIG_SYSTEM_I2CTOOL=y
CONFIG_SYSTEM_SPITOOL=y

# --- POSIX Threading ---
CONFIG_PTHREAD_MUTEX_TYPES=y
CONFIG_PTHREAD_STACK_DEFAULT=4096
CONFIG_SCHED_WAITPID=y
CONFIG_SCHED_CPULOAD=y
CONFIG_SCHED_CPULOAD_SYSCLK=y

# --- Debug (enable during bring-up) ---
CONFIG_DEBUG_FEATURES=y
CONFIG_DEBUG_INFO=y
CONFIG_DEBUG_WARN=y
CONFIG_DEBUG_ERROR=y
CONFIG_SYSLOG=y
CONFIG_SYSLOG_CONSOLE=y
CONFIG_RAMLOG=y
CONFIG_RAMLOG_SYSLOG=y
CONFIG_RAMLOG_BUFSIZE=4096
CONFIG_SYSLOG_DEVPATH="/dev/kmsg"
```
